#include "main.h"

#define SIZE_OF_ARRAY(Array) (sizeof(Array) / sizeof(Array[0]))

typedef struct 
{
	int XPos_Poly;
	int YPos_Poly;
	int XPos_Text;
	int YPos_Text;
	GUI_POINT aPointsDest[8];
} tDrawItContext;

//多边形点坐标
static const GUI_POINT aPoints[] = {   
  {-50,  0},
  {-10, 10},
  {  0, 50},
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  {-10,-10}
};


/***************************************************************************************
  * @brief   显示文本
  * @input
  * @return
***************************************************************************************/
void text_display(void)
{
    GUI_SetBkColor(GUI_BLUE); //设置背景颜色
    GUI_Clear(); //清屏

    GUI_SetFont(&GUI_Font8x16); //设置字体
    GUI_SetPenSize(10); //设置笔大小
    GUI_SetColor(GUI_RED); //红色字体
    GUI_DrawLine(80, 10, 240, 90); //绘线
    GUI_DrawLine(80, 90, 240, 10); //绘线
    GUI_SetBkColor(GUI_BLACK); //设置黑色背景
    GUI_SetColor(GUI_WHITE); //设置字体颜色为白色
    GUI_SetTextMode(GUI_TM_NORMAL); //正常模式
    GUI_DispStringHCenterAt("GUI_TM_NORMAL",160,10);
    GUI_SetTextMode(GUI_TM_REV); //反转文本
    GUI_DispStringHCenterAt("GUI_TM_REV" ,160,26);
    GUI_SetTextMode(GUI_TM_TRANS); //透明文本
    GUI_DispStringHCenterAt("GUI_TM_TRANS" ,160,42);
    GUI_SetTextMode(GUI_TM_XOR); //异或文本
    GUI_DispStringHCenterAt("GUI_TM_XOR" ,160,58);
    GUI_SetTextMode(GUI_TM_TRANS|GUI_TM_REV);//透明反转文本
    GUI_DispStringHCenterAt("GUI_EM_TRANS|GUI_TM_REV",160,74);
    
    
    GUI_WRAPMODE aWm[] = { GUI_WRAPMODE_NONE, GUI_WRAPMODE_CHAR, GUI_WRAPMODE_WORD};
    GUI_RECT Rect ={50,140,150,240}; //定义矩形显示区域
    char acText[] = "This example demonstrates text wrapping";
    GUI_SetTextMode(GUI_TM_TRANS);
    for (uint8_t i = 0; i < 3; i++) {
        GUI_SetColor(GUI_WHITE);
        GUI_FillRectEx(&Rect);
        GUI_SetColor(GUI_BLACK);
        GUI_DispStringInRectWrap(acText, &Rect, GUI_TA_LEFT, aWm[i]);
        Rect.x0 += 120;
        Rect.x1 += 120;
    }
}

/***************************************************************************************
  * @brief   绘制2D图形
  * @input
  * @return
***************************************************************************************/
void draw_2d(void)
{
    GUI_SetBkColor(GUI_BLUE); //设置背景颜色
    GUI_Clear();

    //绘制用水平颜色梯度填充的矩形
    GUI_DrawGradientH(55, 25, 105, 75, 0X4117BB, 0XC6B6F5);
    //绘制用垂直颜色梯度填充的矩形
    GUI_DrawGradientV(110, 25, 160, 75, 0X4117BB, 0XC6B6F5);
    //绘制水平颜色梯度填充的圆角矩形
    GUI_DrawGradientRoundedH(165, 25, 215, 75, 12, 0X4117BB, 0XC6B6F5);
    //绘制垂直颜色梯度填充的圆角矩形
    GUI_DrawGradientRoundedV(220, 25, 270, 75, 12, 0X4117BB, 0XC6B6F5);
    GUI_DrawRect(275, 25, 325, 75); //在当前窗口中指定的位置绘制矩形
    GUI_FillRect(330, 25, 380, 75); //在当前窗口中指定位置绘制填充的矩形区域
    GUI_SetPenSize(5); //设置画笔颜色,单位像素点
    GUI_DrawLine(5, 80, 55, 130); //绘制线条
    for(uint8_t i = 0; i < 25; i += 3)
        GUI_DrawCircle(100, 110, i); //绘制圆，无法绘制半径大于 180 的圆
    //在指定位置绘制指定尺寸的填充的圆,无法绘制半径大于 180 的圆
    GUI_FillCircle(160, 110, 25);
    GUI_SetPenSize(2);
    GUI_SetColor(GUI_CYAN);
    //在指定位置绘制指定尺寸的椭圆的轮廓 无法处理大于 180 的 rx/ry 参数
    GUI_DrawEllipse(225, 110, 35, 25);
    GUI_SetColor(GUI_MAGENTA);
    GUI_FillEllipse(225, 110, 30, 20); //在指定位置绘制指定尺寸的填充的椭圆
    
    /*------------------绘制波形线---------------------------*/
    I16 aY[200];
    int i;
    for(i=0;i<GUI_COUNTOF(aY);i++) 
        aY[i] = rand()%100;
    GUI_ClearRect(0,150,200,200); //每次显示前先清除显示区域
    GUI_DrawGraph(aY,GUI_COUNTOF(aY),0,150);

    /*------------------绘制仪表---------------------------*/
    char ac[4];
    int x0 = 350;
    int y0 = 220;
    GUI_SetPenSize(3);
    GUI_SetTextMode(GUI_TM_TRANS);
    GUI_SetFont(&GUI_FontComic18B_ASCII);
    GUI_SetColor( GUI_BLACK );
    GUI_DrawArc( x0, y0, 100, 100, -30, 210 );//绘制弧线
    GUI_Delay(1000);
    for (uint8_t i = 0; i <= 23; i++) {
        float a = (-30 + i * 10) * 3.1415926 / 180;
        int x = -91 * cos(a) + x0;
        int y = -91 * sin(a) + y0;
        if (i % 2 == 0)
            GUI_SetPenSize( 4 );
        else
            GUI_SetPenSize( 2 );
        GUI_DrawPoint(x, y);
        if (i % 2 == 0) {
            x = -80 * cos(a) + x0;
            y = -80 * sin(a) + y0;
            sprintf(ac, "%d", 10 * i);
            GUI_SetTextAlign(GUI_TA_VCENTER);
            GUI_DispStringHCenterAt(ac, x, y);
        }
    }
    
}

/***************************************************************************************
  * @brief   绘制位图
  * @input
  * @return
***************************************************************************************/
void draw_bitmap(void)
{
    extern GUI_BITMAP bmbitmap;
    GUI_Clear();
    GUI_SetTextMode(GUI_TM_TRANS);	//透明显示
    GUI_DrawBitmap(&bmbitmap, 150, 30); //绘制 ALIENTEK 图标
    GUI_Delay(1000);
    GUI_Clear();
    //位图中坐标为(0,0)的对应显示在LCD的(150,30)点,且缩放倍数为500/1000 = 0.5
    GUI_DrawBitmapEx(&bmbitmap, 150, 30, 0, 0, 500, 500);
}

/***************************************************************************************
  * @brief   混合显示
  * @input
  * @return
***************************************************************************************/
void alpha_display(void)
{
    GUI_EnableAlpha(1); //使能 Alpha 功能
    GUI_SetBkColor(GUI_WHITE); //设置背景颜色
    GUI_Clear();
    GUI_SetTextMode(GUI_TM_TRANS); //文本透明显示
    GUI_SetColor(GUI_BLACK);
    GUI_SetFont(&GUI_Font32_1);
    GUI_DispStringHCenterAt("ALIENTEK ALPHA TEST", 200, 110);
    GUI_SetAlpha(0x40); //设置 alpha 值 0x00-0xFF
    GUI_SetColor(GUI_RED);
    GUI_FillRect(50, 25, 150, 125); //绘制红色矩形
    GUI_SetAlpha(0x80);
    GUI_SetColor(GUI_GREEN);
    GUI_FillRect(100, 75, 200, 175); //绘制绿色矩形
    GUI_SetAlpha(0xC0);
    GUI_SetColor(GUI_BLUE);
    GUI_FillRect(150, 125, 250, 225); //绘制蓝色矩形
    GUI_SetAlpha(0x80);
    GUI_SetColor(GUI_YELLOW);
    GUI_FillRect(200, 75, 300, 175); //绘制黄色矩形
    GUI_SetAlpha(0x40);
    GUI_SetColor(GUI_BROWN);
    GUI_FillRect(250, 25, 350, 125); //绘制棕色矩形
    GUI_SetAlpha(0); //恢复 alpha 通道
}


/*################################################################################################################*/
static GUI_RECT Rect = {200, 100, 300, 160};  
/***************************************************************************************
  * @brief   在存储设备中执行操作
  * @input   
  * @return  
***************************************************************************************/
static void _Draw_mem(void) 
{
	GUI_SetPenSize(5);
	GUI_SetColor(GUI_RED);
	GUI_DrawLine(Rect.x0 + 3, Rect.y0 + 3, Rect.x1 - 3, Rect.y1 - 3);
	GUI_SetColor(GUI_GREEN);
	GUI_DrawLine(Rect.x0 + 3, Rect.y1 - 3, Rect.x1 - 3, Rect.y0 + 3);
	GUI_SetColor(GUI_WHITE);
	GUI_SetFont(&GUI_FontComic24B_ASCII);
	GUI_SetTextMode(GUI_TM_TRANS);
	GUI_DispStringInRect("Closed", &Rect, GUI_TA_HCENTER | GUI_TA_VCENTER);
}

/***************************************************************************************
  * @brief   使用存储设备绘制
  * @input   
  * @return  
***************************************************************************************/

void _DemoMemDev(void) 
{
    GUI_MEMDEV_Handle hMem;
    GUI_SetBkColor(GUI_BLUE);
	GUI_Clear();
    GUI_SetColor(GUI_YELLOW);
	GUI_SetFont(&GUI_Font24_ASCII);
	GUI_DispStringHCenterAt("MEMDEV_MemDev - Sample", 240, 0);
    
    hMem = GUI_MEMDEV_Create(Rect.x0, Rect.y0, Rect.x1 - Rect.x0, Rect.y1 - Rect.y0);	//创建存储设备
	GUI_MEMDEV_Select(hMem);	//选择hMem作为绘制操作目标的存储设备
    _Draw_mem();
    GUI_MEMDEV_Select(0);  		//选中LCD
    while (1) 
	{
		for (uint8_t i = 0; i < 3; i++) 
		{
			GUI_Delay(250);
			GUI_ClearRect(LCD_GetXSize() - Rect.x1, Rect.y0, LCD_GetXSize(), Rect.y1);  //清除选中的屏幕
			GUI_Delay(250);
			GUI_MEMDEV_CopyToLCDAt(hMem, LCD_GetXSize() - Rect.x1, Rect.y0); //将存储设备的内容从内存复制到LCD的指定位置
		}
        GUI_Delay(500);  
	}
}


/*################################################################################################################*/
/***************************************************************************************
  * @brief   
  * @input   
  * @return  
***************************************************************************************/
static void _DrawIt(void * pData) 
{
	tDrawItContext * pDrawItContext = (tDrawItContext *)pData;
	GUI_Clear();
	GUI_SetFont(&GUI_Font8x8);
	GUI_SetTextMode(GUI_TM_TRANS);
 
	//绘制绿色背景的长条
	GUI_SetColor(GUI_GREEN);
	GUI_FillRect(pDrawItContext->XPos_Text, 
               pDrawItContext->YPos_Text - 25,
               pDrawItContext->XPos_Text + 100,
               pDrawItContext->YPos_Text - 5);
    
	//绘制蓝色多边形
	GUI_SetColor(GUI_BLUE);
	GUI_FillPolygon(pDrawItContext->aPointsDest, SIZE_OF_ARRAY(aPoints), 160, 120);
 
	//绘制红色前景的长条
	GUI_SetColor(GUI_RED);
	GUI_FillRect(220 - pDrawItContext->XPos_Text, 
               pDrawItContext->YPos_Text + 5,
               220 - pDrawItContext->XPos_Text + 100,
               pDrawItContext->YPos_Text + 25);
}

/***************************************************************************************
  * @brief   分段存储演示程序
  * @input
  * @return
***************************************************************************************/
void _DemoBandingMemdev(void) 
{
	tDrawItContext DrawItContext;
	int i, swap=0;
	GUI_SetBkColor(GUI_BLACK);
	GUI_Clear();
	GUI_SetColor(GUI_YELLOW);
	GUI_SetFont(&GUI_Font24_ASCII);
	GUI_DispStringHCenterAt("MEMDEV_Banding - Sample", 160, 5);
	GUI_SetFont(&GUI_Font16_ASCII);
	GUI_DispStringHCenterAt("Banding memory device\nwithout flickering", 160, 40);
	DrawItContext.XPos_Poly = 160;
	DrawItContext.YPos_Poly = 120;
	DrawItContext.YPos_Text = 116;
	while (1) 
	{
		swap = ~swap;
		for (i = 0; i < 220; i++) 
		{
			float angle = i * 3.1415926 / 55;
			DrawItContext.XPos_Text = (swap) ? i : 220 - i;
			//旋转多边形
			GUI_RotatePolygon(DrawItContext.aPointsDest, aPoints, SIZE_OF_ARRAY(aPoints), angle);
            
            GUI_RECT Rect = {0, 70, 320,170};//使用的LCD区域
            GUI_MEMDEV_Draw(&Rect,&_DrawIt,&DrawItContext,0,0);//使用分段存储绘制
            GUI_Delay(10);
		}
	}
}


/*################################################################################################################*/
static const unsigned char acScaleR140[] = {
  0x00, 0x00, 0x00, 0x00, 0x00, 0x00, 0x00, 0x00, 0x00, 0x00, 0x00, 0x00,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 0x00,
  0x00, 0x00, 0x00, 0x00, 0x00, 0x00, 0x00, 0x00, 0x00, 0x00, 0x00, 0x00,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 0x00,
  0x00, 0x00, 0x00, 0x00, 0x00, 0x00, 0x00, 0x00, 0x00, 0x00, 0x00, 0x00,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 0x00,
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  0x00, 0x00, 0x00, 0x00, 0x00, 0x00, 0x00, 0x00, 0x00, 0x00, 0x00, 0x00,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 0x00
};

static const GUI_COLOR ColorsScaleR140[] = {
	0x000000, 0x00AA00, 0xFFFFFF, 0x0000AA,
	0x00FF00, 0xAEAEAE, 0x737373, 0xD3D3D3,
	0xDFDFDF, 0xBBDFBB, 0x6161DF, 0x61DF61,
	0xBBBBDF, 0xC7C7C7, 0x616193
};



#define MAG          4
#define DEG2RAD      (3.1415926f / 180)
//PARAM，包含绘图所需信息的结构体
typedef struct 
{
	GUI_AUTODEV_INFO AutoDevInfo;  // Information about what has to be displayed
	GUI_POINT        aPoints[7];   // Polygon data
	float            Angle;
} PARAM;

//多边形的外形
static const GUI_POINT _aNeedle[] = {
	{ MAG * ( 0), MAG * (  0 + 125) },
	{ MAG * (-3), MAG * (-15 + 125) },
	{ MAG * (-3), MAG * (-65 + 125) },
	{ MAG * ( 3), MAG * (-65 + 125) },
	{ MAG * ( 3), MAG * (-15 + 125) },
};

//调色板
static const GUI_LOGPALETTE PalScaleR140 = {
	15,   //条目的数量
	0,    //无透明度
	&ColorsScaleR140[0]
};

static const GUI_BITMAP bmScaleR140 = {
	200,          // XSize
	73,           // YSize
	100,          // BytesPerLine
	4,            // BitsPerPixel
	acScaleR140,  // Pointer to picture data (indices)
	&PalScaleR140 // Pointer to palette
};

/***************************************************************************************
  * @brief   获取角度,这里只是模拟。在实际使用中这个角度应该是一个实际值
  * @input
  * @return
***************************************************************************************/
static float _GetAngle(int tDiff) {
	if (tDiff < 15000) {
		return  225 - 0.006 * tDiff ;
	}
	tDiff -= 15000;
	if (tDiff < 7500) {
		return  225 - 90 + 0.012 * tDiff ;
	}
	return 225;
}

/***************************************************************************************
  * @brief   绘图
  * @input   
  * @return
***************************************************************************************/
static void _Draw(void * p)
{
	PARAM * pParam;
	pParam = (PARAM *)p;
	//显示背景
	if (pParam->AutoDevInfo.DrawFixed) {
		GUI_ClearRect (60, 80 + bmScaleR140.YSize, 60 + bmScaleR140.XSize - 1, 180);
		GUI_DrawBitmap(&bmScaleR140, 60, 80);
	}

	//移动指针
	GUI_SetColor(GUI_WHITE);
	GUI_AA_FillPolygon(pParam->aPoints, SIZE_OF_ARRAY(_aNeedle), MAG * 160, MAG * 220);  //绘制实心无锯齿多边形

	//显示前景色
	if (pParam->AutoDevInfo.DrawFixed) {
		GUI_SetTextMode(GUI_TM_TRANS);
		GUI_SetColor(GUI_RED);
		GUI_SetFont(&GUI_Font24B_ASCII);
		GUI_DispStringHCenterAt("RPM / 1000", 160, 140);
	}
}

/***************************************************************************************
  * @brief   自动设备对象，移动的仪表指针
  * @input
  * @return
***************************************************************************************/
void _DemoScale(void)
{
	GUI_AUTODEV AutoDev;    // Object for banding memory device
	PARAM       Param;      // Parameters for drawing routine
	int         Cnt;
	int         tDiff;
	int         t0;

	//显示信息
	GUI_SetBkColor(GUI_BLACK);
	GUI_Clear();
	GUI_SetColor(GUI_WHITE);
	GUI_SetFont(&GUI_Font24_ASCII);
	GUI_DispStringHCenterAt("MEMDEV_AutoDev - Sample", 160, 5);
	GUI_SetFont(&GUI_Font8x16);
	GUI_DispStringHCenterAt("Scale using GUI_AUTODEV-object", 160, 50);

	//使能高分辨率抗锯齿
	GUI_AA_EnableHiRes();
	GUI_AA_SetFactor(MAG);
	while (1) 
	{
		t0 = GUI_GetTime();	
		GUI_MEMDEV_CreateAuto(&AutoDev); //创建自动设备对象

		for (Cnt = 0; (tDiff = GUI_GetTime() - t0) < 24000; Cnt++) 
		{
			Param.Angle = _GetAngle(tDiff)* DEG2RAD;
			GUI_RotatePolygon(Param.aPoints, _aNeedle, SIZE_OF_ARRAY(_aNeedle), Param.Angle); //按照指定角度旋转多边形
            //printf("函数调用之前:%d\r\n",Param.AutoDevInfo.DrawFixed);
			GUI_MEMDEV_DrawAuto(&AutoDev, &Param.AutoDevInfo, &_Draw, &Param);  //使用自动设备对象绘制图形
            //printf("函数调用之后:%d\r\n",Param.AutoDevInfo.DrawFixed);
		}

		//显示milliseconds / picture图片
		GUI_SetColor(GUI_WHITE);
		GUI_SetFont(&GUI_Font8x16);
		GUI_DispStringHCenterAt("Milliseconds / picture:", 160, 200);
		GUI_SetTextAlign(GUI_TA_CENTER);
		GUI_SetTextMode(GUI_TM_NORMAL);
		GUI_DispNextLine();
		GUI_GotoX(160);
		GUI_DispFloatMin((float)tDiff / (float)Cnt, 2);

		//删除自动设备对象
		GUI_MEMDEV_DeleteAuto(&AutoDev);
		GUI_Delay(3000);
		GUI_ClearRect(0, 70, 319, 239);
	}
}

/*################################################################################################################*/

/***************************************************************************************
  * @brief   背景窗口回调函数
  * @input   
  * @return  
***************************************************************************************/
static void _cbBkWindow(WM_MESSAGE *pMsg)
{
	switch(pMsg->MsgId) //根据不同的消息类型处理
	{
		case WM_PAINT:   //WM_PAIMNT消息，窗口重绘自身
			GUI_ClearRect(0,50,319,239);
			break;
		default:
			WM_DefaultProc(pMsg); //此函数可处理未处理的消息
	}
}

/***************************************************************************************
  * @brief   窗口回调函数
  * @input   
  * @return  
***************************************************************************************/
static void _cbWindow(WM_MESSAGE *pMsg)
{
	GUI_RECT Rect;
	switch(pMsg->MsgId)
	{
		case WM_PAINT:
			WM_GetInsideRect(&Rect); //返回活动窗口减去边界后的尺寸
			GUI_SetBkColor(GUI_RED); //红色背景色
			GUI_SetColor(GUI_YELLOW);//黄色
			GUI_ClearRectEx(&Rect);	 //清除Rect区域,既绘制红色区域
			GUI_DrawRectEx(&Rect);	 //绘制Rect区域,既绘制黄色框框
			GUI_SetColor(GUI_BLACK); //黑色
			GUI_SetFont(&GUI_Font16_ASCII); //设置字体
			GUI_DispStringHCenterAt("Foreground Window",75,40);
			break;
		default:
			WM_DefaultProc(pMsg);
	}
}

/***************************************************************************************
  * @brief   窗口演示
  * @input   
  * @return  
***************************************************************************************/
void _DemoRedraw(void)
{
    WM_HWIN hWnd;
    
	GUI_SetBkColor(GUI_BLACK); 	//设置背景颜色
	GUI_Clear();
	GUI_SetColor(GUI_WHITE);	//白色
	GUI_SetFont(&GUI_Font24_ASCII);//设置字体
	GUI_DispStringHCenterAt("WM_Redraw-Sample",160,5);
	GUI_SetFont(&GUI_Font16B_ASCII); //设置字体
	while(1)
	{
		//为背景窗口设置回调函数
		WM_SetCallback(WM_HBKWIN,_cbBkWindow);
		
        //创建前景窗口
        hWnd = WM_CreateWindow(10,50,150,100,WM_CF_SHOW,_cbWindow,0);
        
		//移动前景窗口
        for(uint8_t i=0; i<40; i++){
            WM_MoveWindow(hWnd,2,2); //移动窗口
            GUI_Delay(10);
        }
        GUI_Delay(1000);
        //删除前景窗口
        WM_DeleteWindow(hWnd); //删除窗口
        WM_Invalidate(WM_HBKWIN); //背景窗口无效
        GUI_Exec(); 
	}
}


/*################################################################################################################*/










